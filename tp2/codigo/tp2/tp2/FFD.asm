/*
 * Flip flod D inmplementation in ASM for an ATMEGA328p
 *
 *  Created: 17/05/2020 18:45:26
 *   Author: Fabricio
 */ 


 /*
   PINES DE ENTRADA 0 (CLOCK) Y 1 (D) 
   PIN DE SALIDA 2 (Q)
 */
.EQU CK = 0
.EQU D = 1
.EQU Q = 2
.EQU PUERTO_SALIDA = PORTB
.EQU PUERTO_ENTRADA = PINB
.EQU CONF_PUERTO = DDRB

.CSEG

	JMP MAIN

.ORG INT_VECTORS_SIZE 

MAIN:

; INICIALIZO PUERTOS
	LDI R22, (0<<0 | 0<<1 | 1<<2)
	OUT CONF_PUERTO, R22

; DETECTO FLANCO DESCENTENTE
BAJO: 
	SBIS PUERTO_ENTRADA, CK
	JMP BAJO
ALTO:
	SBIC PUERTO_ENTRADA, CK
	JMP ALTO

; COPIO VALOR DE ENTRADA A LA SALIDA
	SBIC PUERTO_ENTRADA, D
	JMP SET_HIGH
	CBI PUERTO_SALIDA, Q
	JMP BAJO ; VUELVO A DETECTAR FLANCO
SET_HIGH:	 
	SBI PUERTO_SALIDA, Q
	JMP BAJO 

ACA: JMP ACA
